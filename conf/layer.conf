## conf/layer.conf
```bitbake
BBFILE_PRIORITY_meta-waveshare-dsi-display = "10"
LAYERDEPENDS_meta-waveshare-dsi-display = "core"
BBFILES += "${LAYERDIR}/recipes*/*/*.bb \
            ${LAYERDIR}/recipes*/*/*.bbappend"
BBFILE_COLLECTIONS += "meta-waveshare-dsi-display"
COMPATIBLE_MACHINE_meta-waveshare-dsi-display = "(raspberrypi4-64)"

BBFILE_PATTERN_meta-waveshare-dsi-display = "^${LAYERDIR}/"
LAYERSERIES_COMPAT_meta-waveshare-dsi-display = "mickledore"
```
